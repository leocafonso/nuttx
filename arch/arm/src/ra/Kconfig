## arch/arm/src/ra/Kconfig
```kconfig
#
# For a description of the syntax of this configuration file,
# see the file kconfig-language.txt in the NuttX tools repository.
#

comment "RA Configuration Options"

choice
	prompt "RA Chip Selection"
	default ARCH_CHIP_R7FA4M1ABxxFP
	depends on ARCH_CHIP_RA

config ARCH_CHIP_R7FA4M1ABxxFP 
	bool "R7FA4M1ABxxFP"
	select RA_HAVE_SCI0
	select RA_HAVE_SCI1
	select RA_HAVE_SCI2
	select RA_HAVE_SCI9
	select RA4M1_FAMILY

endchoice # RA4 Chip Selection

config RA4M1_FAMILY
	bool
	default n
	select ARCH_CORTEXM4

menu "RA4M1 Peripheral Support"

config RA_HAVE_SCI0
	bool
	default n

config RA_HAVE_SCI1
	bool
	default n

config RA_HAVE_SCI2
	bool
	default n

config RA_HAVE_SCI9
	bool
	default n

config RA_SCI0
	bool "UART 0"
	default n
	depends on RA_HAVE_SCI0
	select UART0_SERIALDRIVER
	select ARCH_HAVE_SERIAL_TERMIOS

config RA_SCI1
	bool "UART 1"
	default n
	depends on RA_HAVE_SCI1
	select UART0_SERIALDRIVER
	select ARCH_HAVE_SERIAL_TERMIOS

config RA_SCI2
	bool "UART 2"
	default y
	depends on RA_HAVE_SCI2
	select UART2_SERIALDRIVER
	select ARCH_HAVE_SERIAL_TERMIOS

config RA_SCI9
	bool "UART 9"
	default n
	depends on RA_HAVE_SCI9
	select UART9_SERIALDRIVER
	select ARCH_HAVE_SERIAL_TERMIOS

endmenu # AT91SAM3/4 Peripheral Support
```

## arch/arm/src/ra4m1/Kconfig
```kconfig
#
# For a description of the syntax of this configuration file,
# see the file kconfig-language.txt in the NuttX tools repository.
#

comment "RA4M1 Configuration Options"

choice
	prompt "RA4M1 Chip Selection"
	default ARCH_CHIP_R7FA4M1ABxxFP
	depends on ARCH_CHIP_RA4M1

config ARCH_CHIP_R7FA4M1ABxxFP 
	bool "R7FA4M1ABxxFP"
	select ARCH_CORTEXM4

endchoice # RA4M1 Chip Selection
```
